
/************************************************************************************
 * 	
 * 	Name    : Iron Man Gauntlet Work In Progress Sketch                    
 * 	Author  : Ross Hendrickson http://savorywatt.com                       
 * 	Date    : 10/30/2012                                    
 * 	Version : 0.1   
 *      Notes   : Build photos and instructions at http://savorywatt.com 
 *
 ***********************************************************************************/

/*
* Psuedo code
* Three states
*  - Stable pulsing glow
*  - Ramp up to firing
*  - Firing animation
*
* Three thresholds, one for each state
* 
* while(currentState == STATIC)
* checkState
* manipulate LED array
* play||don't play sound
*
* checkstate
*   check accelerometer y axis and compare verses thresholds
*
*/
#include <I2C.h>
#include <MMA8453_n0m1.h>
#include <PCM.h>

#define STABLE 0
#define RAMP 1
#define FIRE 2

//declare global variables
MMA8453_n0m1 accel;
int currentState = STABLE;
int previousState = 0;
int whiteled = 6; 
int blueled = 5;
int smoothValue = 0;

//The relationship of the angles of the gauntlet and the state
int stableThreshold = 0;
int rampThreshold = 60;
int fireThreshold = 160;

//The amount of time in seconds that you have pass the fire threshold
float fireDelay = 1.0;
boolean timeFire = false;
float fireStart = 0;
float fireEnd = 0;

//sound timing
int soundStart = 0;
int soundEnd = 0;
boolean playing = false;


//Audio data for the two states
const unsigned char ramp_up[] PROGMEM = {
129, 128, 128, 129, 129, 129, 129, 128, 128, 127, 127, 127,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 138
};

const unsigned char ramp_down[] PROGMEM = {
129, 128, 128, 128, 129, 129, 127, 128, 127, 127, 128, 127,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 96
};

const unsigned char fire[] PROGMEM = {
130, 127, 126, 130, 126, 128, 132, 127, 127, 128, 124, 127,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 167
};

void setup()  {

  //Serial.begin(9600);
  accel.setI2CAddr(0x1D); //change your device address if necessary, default is 0x1C
  accel.dataMode(true, 2); //enable highRes 10bit, 2g range [2g,4g,8g]
}

void loop()  {
  
  //stable
  if(currentState == STABLE)
  {
    stableState();
  }
  
  //ramp
  if(currentState == RAMP)
  {
    rampState();
  }
  
  //fire
  if(currentState == FIRE)
  {
    fireState();
  }
  
}

int checkState()  {
  
   accel.update();
   
   float currentX = accel.x();
   
   //check for stable
   if (currentX < rampThreshold)
   {
     if (currentState != STABLE){
     previousState = currentState;
     }
     currentState = STABLE;
     timeFire = false;
     fireEnd = 0;
     fireStart = 0;
   }
   //check for ramp
   if (currentX >= rampThreshold && currentX < fireThreshold)
   {
      if (currentState != RAMP){
     previousState = currentState;
     }
     currentState = RAMP;
      timeFire = false;
      fireEnd = 0;
      fireStart = 0;
   }
   //check for fire
  if (currentX >= fireThreshold)
  {
    if (timeFire)
    {
      fireEnd = millis();
      float elapsed = fireEnd - fireStart;
      
      if (elapsed > fireDelay * 1000)
      {
        if (currentState != FIRE){
     previousState = currentState;
     }
      
        currentState = FIRE;
        timeFire = false;
      }
      
    }else{
       
       timeFire = true; 
       fireStart = millis();
    }
  }
  
  //debug
//  Serial.print("CurrentState: ");
//  Serial.print(currentState);
//  Serial.print("\t");
//  Serial.print("currentX: ");
//  Serial.println(currentX);
}

void pulseLED(int ledOne, int ledTwo, int fadeRate, int state) {
  
  //int fadeValue = smoothValue > 0 ? smoothValue : 20; 
  
   // fade in from min to max in increments denoted by the fadeRate:
  for(int fadeValue = 20; fadeValue <= 255; fadeValue +=fadeRate) { 
    // sets the value (range from 0 to 255):
    analogWrite(ledOne, fadeValue);
    analogWrite(ledTwo, fadeValue);
    //check if we need to break if we're not in the current state
    checkState();
    if (currentState != state)
    {
      analogWrite(ledOne, 0);
      analogWrite(ledTwo, 0);
      break;
    }    
    // wait for 30 milliseconds to see the dimming effect    
    delay(30);                            
  } 

  //fadeValue = smoothValue > 0 ? smoothValue : 255;
  // fade out from max to min in increments of 5 points:
  for(int fadeValue = 255; fadeValue >= 20; fadeValue -=fadeRate) { 
    // sets the value (range from 0 to 255):
    analogWrite(ledOne, fadeValue);
    analogWrite(ledTwo, fadeValue);  
   //check if we need to break if we're not in the current state
    checkState();
    if (currentState != state)
    {
      analogWrite(ledOne, 0);
      analogWrite(ledTwo, 0);
      break;
    }
    // wait for 30 milliseconds to see the dimming effect    
    delay(30);                            
  } 
  
  
}

//gently pulse LED array
void stableState(){
  
    //reset any sounds playing to false; 
    stopPlayback();
    playing = false;
    soundStart = 0;
    soundEnd = 0;
 
  //pulse the LED but check state and break if needed
  pulseLED(whiteled, blueled, 10, STABLE);
 
}

//brighten LED array until fire state is triggered or not then dim or switch
//play ramp whine
void rampState(){
  
   //Coming from STABLE
   if (previousState == STABLE && !playing)
   {
     startPlayback(ramp_up, sizeof(ramp_up));
     playing = true;
     soundStart = millis();
   }
   
   if (playing)
   {
     soundEnd = millis();
     float elapsed = soundEnd - soundStart;
     if (elapsed > 2000)
     {
       playing = false;
       stopPlayback(); 
       soundStart = 0;
       soundEnd = 0;
     }
   }
   
   //Coming down from Fire
   if (previousState == FIRE && !playing)
   {
       startPlayback(ramp_down, sizeof(ramp_down));
       playing = true;
       soundStart = millis();
   }
   
  pulseLED(whiteled, blueled, 40, RAMP);
   
}

//Flash LED and play fire sound
void fireState(){
  
   //Coming from RAMP
   if (previousState == RAMP && !playing){
     startPlayback(fire, sizeof(fire));
     playing = true;
     soundStart = millis();
   }
   
   if (playing)
   {
     soundEnd = millis();
     float elapsed = soundEnd - soundStart;
     if (elapsed > 2000)
     {
       playing = false;
       stopPlayback(); 
       soundStart = 0;
       soundEnd = 0;
       
     }
   }
  
   pulseLED(whiteled, blueled, 80, FIRE);

}


